/**************************************************************************************************
  Filename:       hal_lcd.c
  Revised:        $Date: 2010-2-25 17:25 $
  Revision:       $Revision: 0001 $

  Description:    This file contains the interface to the HAL LCD Service.
                  WCG160100   UC1608

  西安华凡科技有限公司
  www.zigbeehf.com
  www.zigbeehf.com.cn

**************************************************************************************************/

/**************************************************************************************************
 *                                           INCLUDES
 **************************************************************************************************/
#include "hal_types.h"
#include "hal_lcd.h"
#include "OSAL.h"
#include "OnBoard.h"

#ifdef ZTOOL_PORT
  #include "DebugTrace.h"
#endif
#include "intrinsics.h"

#define LCD_MAX_BUF 25
//hal_lcd.h 中预定义液晶型号
//LCD160100

#ifdef LCD160100
//***************************************************************************//
//液晶为160X100 UC1608控制器
//***************************************************************************//

// LCD port/bit definitions
#define LCD_CD                 P1_4
#define LCD_WR0                P1_5
#define LCD_SCLK               P1_7
#define LCD_SDIN               P1_6

//english_8x16_pixel
// 8 x 16 font
// index = ASCII - 32
// ------------------  ASCII字模的数据表 ------------------------ //
// 码表从0x20~0x7e                                                //
// 字库:  横向取模左高位     //
// -------------------------------------------------------------- //
__code const unsigned char font8x16[][16] =              // ASCII
{
	0x00,0x00,0x00,0x00,0x00,0x00,0x00,0x00,  // - -
	0x00,0x00,0x00,0x00,0x00,0x00,0x00,0x00,

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	0x18,0x18,0x18,0x18,0x18,0x18,0x7E,0x7E,
};

#else

//***************************************************************************//
//液晶为84x48 3310
//***************************************************************************//

// LCD port/bit definitions
#define LCD_DC                 P1_7
#define LCD_SDA                P1_6
#define LCD_SCL                P1_5
#define LCD_CE                 P1_4

/**************************************/
//english_6x8_pixel
// 6 x 8 font
// 1 pixel space at left and bottom
// index = ASCII - 32
__code const unsigned char font6x8[][6] =
{
  { 0x00, 0x00, 0x00, 0x00, 0x00, 0x00 },   // sp  0
  { 0x00, 0x00, 0x00, 0x2f, 0x00, 0x00 },   // !   1
  { 0x00, 0x00, 0x07, 0x00, 0x07, 0x00 },   // "   2
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  { 0x00, 0x20, 0x40, 0xff, 0x40, 0x20 }    // down  95
};

#endif
/**************************************************************************************************
 *                                       GLOBAL VARIABLES
 **************************************************************************************************/
#ifdef LCD_HW
static uint8 *Lcd_Line1;
#endif
/**************************************************************************************************
 *                                       FUNCTIONS - API
 **************************************************************************************************/
#if (defined LCD_HW) && (HAL_LCD == TRUE)

#ifdef LCD160100
//***************************************************************************//
//液晶为160X100 UC1608控制器
//***************************************************************************//

/************ 延时函数 ******************************/

//延时n us

static void Delay_us(unsigned int n)
{
  unsigned int i;
  unsigned int j;
  for(i = 0; i < n; i++)
  for(j = 1; j<0x05; j++)
      ;
}

//164输出数据

static void OutData_164(unsigned char Indata)
{
  unsigned char i;
  for(i=0;i<8;i++)
  {
    if(Indata&0x80)
    {
      LCD_SDIN=1;
    }
    else
    {
      LCD_SDIN=0;
    }
    LCD_SCLK=0;
    __no_operation();
    __no_operation();
    LCD_SCLK=1;
    __no_operation();
    __no_operation();
    LCD_SCLK=0;
    Indata=Indata<<1;	
  }
}

//写数据

static void DatWrite(unsigned char dat)
{	
  LCD_CD=1;
  LCD_WR0=0;
  OutData_164(dat);
  Delay_us(1);
  LCD_WR0=1;
  Delay_us(1);
}

//写命令

static void ComWrite(unsigned char com)
{
  LCD_CD=0;
  LCD_WR0=0;
  OutData_164(com);
  Delay_us(1);
  LCD_WR0=1;
  Delay_us(1);
}

static void Disp(unsigned char dot1 , unsigned char dot2)
{
  unsigned char cnt, cnt1;
  for(cnt = 0; cnt < 13; cnt ++)
  {
    ComWrite(0xb0 + cnt);
    ComWrite(0x10);
    ComWrite(0x00);
    for(cnt1=0; cnt1 < 80; cnt1 ++)
    {
      DatWrite(dot1);
      DatWrite(dot2);
    }

  }
}

/*-----------------------------------------------------------------------
LCD_clear         : LCD清屏函数

编写日期          ：2004-8-10
最后修改日期      ：2004-8-10
-----------------------------------------------------------------------*/
static void LCD_clear(void)
{
  Disp(0x00,0x00);
}

/*-----------------------------------------------------------------------
LCD_init          : LCD初始化

编写日期          ：2004-8-10
最后修改日期      ：2004-8-10
-----------------------------------------------------------------------*/
static void initLcd(void)
{
  unsigned char Ratio = 0x2d;//Set Power Controlc=<26;d:26-43
  unsigned char Refer = 0x6d;//Set reference voltage register
  // CC2430 中，I/O 口做普通 I/O 使用时和每个 I/O 端口相关的寄存器有 3 个，分别是 //PxSEL
  //功能选择寄存器，PxDIR 方向寄存器，PxINP 输入模式寄存器，其中 x 为 0，1，2 。

  P1SEL &= 0x0F; //P1高4位 为普通 I/O 口
  P1DIR |= 0xF0; //P1高4位 设置为输出

  Delay_us(2000);
  ComWrite(0xe2);      // Reset
  Delay_us(500);
  ComWrite(0xae);      // Display Off
  ComWrite(0x24);      // MUX ratio(duty)=1/128 & temperature compensation
  ComWrite(0xc4);      // Set LCD mapping control
  ComWrite(0x2d);      // set internal charge pump---new
  ComWrite(0xea);      // lcd bias 1/12//ea  e911.3  e810.7   eb12.7
  ComWrite(Ratio);     // Set Power Control(capacitance of LCD and internal Vlcd)
  ComWrite(0x81);      // Set gain and potentiometer (Double Byte Command)
  ComWrite(Refer);     // Set reference voltage register
//  ComWrite(0x90);      // Set fixed lines
  ComWrite(0x8c);      // Set RAM Address Control
  ComWrite(0xaf);      // Display On
  ComWrite(0x40);      // Set Display Start Line
  LCD_clear();	       // Clear LCD
}


//16X16横向字模转纵向字模

static void Adj_Data_16X16(unsigned char  *Src_Dat,unsigned char *Dst_Dat)
{
  unsigned char i,j;
  for(i=0;i<32;i++)
  {
    *(Dst_Dat+i)=0;
  }
  for(j=0;j<8;j++)
  {
    for(i=0;i<8;i++)
    {
      *(Dst_Dat+j*2)      |=  (((*(Src_Dat+i*2))>>(7-j))&0x01)<<i;
      *(Dst_Dat+j*2+1)    |=  (((*(Src_Dat+i*2+16))>>(7-j))&0x01)<<i;
      *(Dst_Dat+j*2+16)   |=  (((*(Src_Dat+i*2+1))>>(7-j))&0x01)<<i;
      *(Dst_Dat+j*2+1+16) |=  (((*(Src_Dat+i*2+16+1))>>(7-j))&0x01)<<i;
    }
  }
}

//8X16横向字模转纵向字模

static void Adj_Data_8X16(unsigned char  *Src_Dat,unsigned char *Dst_Dat)
{
  unsigned char i,j;
  for(i=0;i<16;i++)
  {
    *(Dst_Dat+i)=0;
  }
  for(j=0;j<8;j++)
  {
    for(i=0;i<8;i++)
    {
      *(Dst_Dat+j*2)      |=  (((*(Src_Dat+i))>>(7-j))&0x01)<<i;
      *(Dst_Dat+j*2+1)    |=  (((*(Src_Dat+i+8))>>(7-j))&0x01)<<i;
    }
  }
}

//清除行

static void LCD_clear_line(unsigned char line)
{
  unsigned char cnt, cnt1;
  for(cnt = line*2; cnt < line*2+2; cnt ++)
  {
    ComWrite(0xb0 + cnt);
    ComWrite(0x10);
    ComWrite(0x00);
    for(cnt1=0; cnt1 < 80; cnt1 ++)
    {
      DatWrite(0);
      DatWrite(0);
    }
  }
}

/*-----------------------------------------------------------------------
LCD_write_english_String  : 英文字符串显示函数

输入参数：*s      ：英文字符串指针；
X、Y    : 显示字符串的位置,x 0-151 ,y 0-5

编写日期          ：2004-8-10
最后修改日期      ：2004-8-10 		
-----------------------------------------------------------------------*/
static void LCD_write_english_string(unsigned char X,unsigned char Y,uint8 *s)
{
  unsigned char m, n;
  unsigned char LSB_Data,MSB_Data;
  unsigned char data_new[16];
  unsigned char i,j;
  LCD_clear_line(Y);
  n=0;
  while(*s)
  {
    //横线字模转换为纵向字模
    for(i=0;i<16;i++)
    {
      data_new[i]=0;
    }
    for(j=0;j<8;j++)
    {
      for(i=0;i<8;i++)
      {
        data_new[j*2]   |= ((font8x16[*s-0x20][i]>>(7-j))&0x01)<<i;
        data_new[j*2+1] |= ((font8x16[*s-0x20][i+8]>>(7-j))&0x01)<<i;
      }
    }

    //液晶显示
    ComWrite(0xb0+0+Y*2);
    for(m=0;m<8;m++)
    {
      LSB_Data=(m+n*8+X)&0x0f;
      MSB_Data=(((m+n*8+X)>>4)&0x0f)|0x10;
      ComWrite(LSB_Data);
      ComWrite(MSB_Data);
      DatWrite(data_new[m*2]);
    }
    ComWrite(0xb0+1+Y*2);
    for(m=0;m<8;m++)
    {
      LSB_Data=(m+n*8+X)&0x0f;
      MSB_Data=(((m+n*8+X)>>4)&0x0f)|0x10;
      ComWrite(LSB_Data);
      ComWrite(MSB_Data);
      DatWrite(data_new[m*2+1]);
    }
    s++;
    n++;
    if(n>=HAL_LCD_MAX_CHARS)return;
  }

}


/******************************************************************************
* See lcd.h for a description of this function.
******************************************************************************/
static void lcdUpdateChar(unsigned char line, unsigned char position, char c)
{
  unsigned char i,j;
  unsigned char LSB_Data,MSB_Data;
  unsigned char data_new[16];

  //横线字模转换为纵向字模
  for(i=0;i<16;i++)
  {
    data_new[i]=0;
  }
  for(j=0;j<8;j++)
  {
    for(i=0;i<8;i++)
    {
      data_new[j*2]    |= ((font8x16[c-0x20][i]>>(7-j))&0x01)<<i;
      data_new[j*2+1]  |= ((font8x16[c-0x20][i+8]>>(7-j))&0x01)<<i;
    }
  }

  //液晶显示
  ComWrite(0xb0+0+line*2);
  for(i=0;i<8;i++)
  {
    LSB_Data=(i+position*8)&0x0f;
    MSB_Data=(((i+position*8)>>4)&0x0f)|0x10;
    ComWrite(LSB_Data);
    ComWrite(MSB_Data);
    DatWrite(data_new[i*2]);
  }
  ComWrite(0xb0+1+line*2);
  for(i=0;i<8;i++)
  {
    LSB_Data=(i+position*8)&0x0f;
    MSB_Data=(((i+position*8)>>4)&0x0f)|0x10;
    ComWrite(LSB_Data);
    ComWrite(MSB_Data);
    DatWrite(data_new[i*2+1]);
  }
}

/******************************************************************************
* See lcd.h for a description of this function.
******************************************************************************/
static void lcdUpdateLine(uint8 line, uint8 *pLine)
{
  LCD_write_english_string(0,line,pLine);
}

/*
void disp_hanzi(unsigned char Xdata,unsigned char Ydata,unsigned char const *Disp_Data,unsigned char len)
{
   uchar i, j,k;
   uchar LSB_Data,MSB_Data;
   uchar hanzi_new[10][32];
   for(i=0;i<len;i++)
   {
     Adj_Data_16X16(Disp_Data+i*32,&hanzi_new[i][0]);
   }

   for(j=0;j<len;j++)
   {
   	
    ComWrite(0xb0+0+Ydata*2);
    for(i=0;i<16;i++)
    {
    	LSB_Data=(i+j*16+Xdata)&0x0f;
    	MSB_Data=(((i+j*16+Xdata)>>4)&0x0f)|0x10;
      ComWrite(LSB_Data);
      ComWrite(MSB_Data);
      DatWrite(hanzi_new[j][i*2]);
    }

    ComWrite(0xb0+1+Ydata*2);

    for(i=0;i<16;i++)
    {
    	LSB_Data=(i+j*16+Xdata)&0x0f;
    	MSB_Data=(((i+j*16+Xdata)>>4)&0x0f)|0x10;
      ComWrite(LSB_Data);
      ComWrite(MSB_Data);
      DatWrite(hanzi_new[j][i*2+1]);
    }
  }
}

*/

#else

//***************************************************************************//
//液晶为84X48 3310 
//***************************************************************************//

/************ 延时函数 ******************************/
static void Delay_nms(unsigned int Time) // 延时单位:ms
{
  unsigned int i;
  unsigned char j;

  for(i=0;i<Time;i++)
  {
    for(j=0;j<123;j++){}
  }
}

/******** 发送一个字节的数据到液晶控制器*************************/
static void SendByte(unsigned char Data)
{
  unsigned char i;
  LCD_CE=0;
  for(i=0;i<8;i++)
  {
    LCD_SCL = 0;
    if(Data & 0x80)
    {
      LCD_SDA = 1;
    }
    else LCD_SDA = 0;
    LCD_SCL = 1;
    Data<<=1;
  }
  LCD_CE=1;
}

/*-----------------------------------------------------------------------
LCD_write_byte    : 使用SPI接口写数据到LCD

输入参数：data    ：写入的数据；
command ：写数据/命令选择；

编写日期          ：2004-8-10
最后修改日期      ：2004-8-13
-----------------------------------------------------------------------*/
static void LCD_write_byte(unsigned char data, unsigned char command)
{
  LCD_CE = 1 ;		 // 使能LCD

  if (command == 0)
    LCD_DC = 0;	        // 传送命令
  else
    LCD_DC = 1;		// 传送数据
  SendByte(data);
  LCD_CE = 0;	        // 关闭LCD
  LCD_DC = 1;	
}

/*-----------------------------------------------------------------------
LCD_clear         : LCD清屏函数

编写日期          ：2004-8-10
最后修改日期      ：2004-8-10
-----------------------------------------------------------------------*/
static void LCD_clear(void)
{
  unsigned int i;

  LCD_write_byte(0x0c, 0);
  LCD_write_byte(0x80, 0);

  for (i=0; i<504; i++)
    LCD_write_byte(0, 1);
}

/*-----------------------------------------------------------------------
LCD_set_XY        : 设置LCD坐标函数

输入参数：X       ：0－83
Y       ：0－5

编写日期          ：2004-8-10
最后修改日期      ：2004-8-10
-----------------------------------------------------------------------*/
static void LCD_set_XY(unsigned char X, unsigned char Y)
{
  LCD_write_byte(0x40 | Y, 0);	// column
  LCD_write_byte(0x80 | X, 0);  // row
}

/*-----------------------------------------------------------------------
LCD_write_char    : 显示英文字符

输入参数：c       ：显示的字符；

编写日期          ：2004-8-10
最后修改日期      ：2004-8-10
-----------------------------------------------------------------------*/
static void LCD_write_char(unsigned char c)
{
  unsigned char line;

  c -= 32;
  for (line=0; line<6; line++)
    LCD_write_byte(font6x8[c][line], 1);
}

/*-----------------------------------------------------------------------
LCD_init          : 3310LCD初始化

编写日期          ：2004-8-10
最后修改日期      ：2004-8-10
-----------------------------------------------------------------------*/
static void initLcd(void)
{
  // CC2430 中，I/O 口做普通 I/O 使用时和每个 I/O 端口相关的寄存器有 3 个，分别是 //PxSEL
  //功能选择寄存器，PxDIR 方向寄存器，PxINP 输入模式寄存器，其中 x 为 0，1，2 。

  P1SEL &= 0x0F; //P1高4位 为普通 I/O 口
  P1DIR |= 0xF0; //P1高4位 设置为输出

  LCD_CE = 0;    // 关闭LCD
  Delay_nms(1);
  LCD_CE = 1;    // 使能LCD
  Delay_nms(1);

  LCD_write_byte(0x21, 0);	// 使用扩展命令设置LCD模式
  LCD_write_byte(0xc8, 0);	// 设置偏置电压
  LCD_write_byte(0x06, 0);	// 温度校正
  LCD_write_byte(0x13, 0);	// 1:48
  LCD_write_byte(0x20, 0);	// 使用基本命令
  LCD_clear();	                // 清屏
  LCD_write_byte(0x0c, 0);	// 设定显示模式，正常显示
  LCD_CE=0 ;                    // 关闭LCD
}


/*-----------------------------------------------------------------------
LCD_write_english_String  : 英文字符串显示函数

输入参数：*s      ：英文字符串指针；
X、Y    : 显示字符串的位置,x 0-83 ,y 0-5

编写日期          ：2004-8-10
最后修改日期      ：2004-8-10 		
-----------------------------------------------------------------------*/
static void LCD_write_english_string(unsigned char X,unsigned char Y,uint8 *s)
{
  unsigned char i=0;
  LCD_set_XY(0,Y);//把第Y行清零
  for(i=0;i<HAL_LCD_MAX_CHARS*6;i++)
  {
    LCD_write_byte(0,1);
  }
  LCD_set_XY(X,Y);
  i=0;
  while (*s)
  {
    LCD_write_char(*s);
    s++;
    i++;
    if(i>=HAL_LCD_MAX_CHARS)return;
  }
}

/******************************************************************************
* See lcd.h for a description of this function.
******************************************************************************/
static void lcdUpdateLine(uint8 line, uint8 *pLine) {
  LCD_write_english_string(0,line,pLine);
}

#endif

#endif


/**************************************************************************************************
 * @fn      HalLcdInit
 *
 * @brief   Initilize LCD Service
 *
 * @param   init - pointer to void that contains the initialized value
 *
 * @return  None
 **************************************************************************************************/
void HalLcdInit(void)
{
#if (HAL_LCD == TRUE)

#ifdef LCD_HW
  Lcd_Line1 = NULL;
  initLcd();
#endif

#endif /* HAL_LCD */

}

/*************************************************************************************************
 *                    LCD EMULATION FUNCTIONS
 *
 * Some evaluation boards are equipped with Liquid Crystal Displays
 * (LCD) which may be used to display diagnostic information. These
 * functions provide LCD emulation, sending the diagnostic strings
 * to Z-Tool via the RS232 serial port. These functions are enabled
 * when the "LCD_SUPPORTED" compiler flag is placed in the makefile.
 *
 * Most applications update both lines (1 and 2) of the LCD whenever
 * text is posted to the device. This emulator assumes that line 1 is
 * updated first (saved locally) and the formatting and send operation
 * is triggered by receipt of line 2. Nothing will be transmitted if
 * only line 1 is updated.
 *
 *************************************************************************************************/


/**************************************************************************************************
 * @fn      HalLcdWriteString
 *
 * @brief   Write a string to the LCD
 *
 * @param   str    - pointer to the string that will be displayed
 *          option - display options
 *
 * @return  None
 **************************************************************************************************/
void HalLcdWriteString ( char *str, uint8 option)
{
#if (HAL_LCD == TRUE)

#ifdef LCD_SD
  byte x;
  byte bln;
  byte sln;
  char *buf;

  if ( Lcd_Line1 == NULL )
  {
    // Set up system start-up message
    Lcd_Line1 = osal_mem_alloc( MAX_LCD_CHARS+1 );
    HalLcdWriteString( "Figure8 Wireless", HAL_LCD_LINE_1 );
  }

  sln = (byte)osal_strlen( str );

  // Check boundries
  if ( sln > MAX_LCD_CHARS )
    sln = MAX_LCD_CHARS;

  if ( option == HAL_LCD_LINE_1 ) {
    // Line 1 gets saved for later
    osal_memcpy( Lcd_Line1, str, sln );
    Lcd_Line1[sln] = '\0';
  }
  else {
    // Line 2 triggers action
    x = (byte)osal_strlen( (char*)Lcd_Line1 );
    bln = x + 1 + sln + 1;
    buf = osal_mem_alloc( bln );
    if ( buf != NULL ) {
      // Concatenate strings
      osal_memcpy( buf, Lcd_Line1, x );
      buf[x++] = ' ';
      osal_memcpy( &buf[x], str, sln );
      buf[x+sln] = '\0';
      // Send it out
#ifdef ZTOOL_PORT
      debug_str( (byte*)buf );
#endif
      osal_mem_free( buf );
    }
  }
#endif // LCD_SD

#ifdef LCD_HW
  lcdUpdateLine( option, (byte*)str );
#endif

#endif /* HAL_LCD */

}

/**************************************************************************************************
 * @fn      HalLcdWriteValue
 *
 * @brief   Write a value to the LCD
 *
 * @param   value  - value that will be displayed
 *          radix  - 8, 10, 16
 *          option - display options
 *
 * @return  None
 **************************************************************************************************/
void HalLcdWriteValue ( uint32 value, const uint8 radix, uint8 option)
{
#if (HAL_LCD == TRUE)
  uint8 buf[LCD_MAX_BUF];

  _ltoa( value, &buf[0], radix );
  HalLcdWriteString( (char*)buf, option );
#endif /* HAL_LCD */
}

/**************************************************************************************************
 * @fn      HalLcdWriteScreen
 *
 * @brief   Write a value to the LCD
 *
 * @param   line1  - string that will be displayed on line 1
 *          line2  - string that will be displayed on line 2
 *
 * @return  None
 **************************************************************************************************/
void HalLcdWriteScreen( char *line1, char *line2 )
{
#if (HAL_LCD == TRUE)
  HalLcdWriteString( line1, HAL_LCD_LINE_1 );
  HalLcdWriteString( line2, HAL_LCD_LINE_2 );
#endif /* HAL_LCD */
}

/**************************************************************************************************
 * @fn      HalLcdWriteStringValue
 *
 * @brief   Write a string followed by a value to the LCD
 *
 * @param   title  -
 *          value  -
 *          format -
 *          line   -
 *
 * @return  None
 **************************************************************************************************/
void HalLcdWriteStringValue( char *title, uint16 value, uint8 format, uint8 line )
{
#if (HAL_LCD == TRUE)
  uint8 tmpLen;
  uint8 buf[LCD_MAX_BUF];
  uint32 err;

  tmpLen = (uint8)osal_strlen( (char*)title );
  osal_memcpy( buf, title, tmpLen );
  buf[tmpLen] = ' ';
  err = (uint32)(value);
  _ltoa( err, &buf[tmpLen+1], format );
  HalLcdWriteString( (char*)buf, line );		
#endif /* HAL_LCD */
}

/**************************************************************************************************
 * @fn      HalLcdWriteStringValue
 *
 * @brief   Write a string followed by a value to the LCD
 *
 * @param   title   -
 *          value1  -
 *          format1 -
 *          value2  -
 *          format2 -
 *          line    -
 *
 * @return  None
 **************************************************************************************************/
void HalLcdWriteStringValueValue( char *title, uint16 value1, uint8 format1,
                                  uint16 value2, byte format2, uint8 line )
{
#if (HAL_LCD == TRUE)
  uint8 tmpLen;
  uint8 buf[LCD_MAX_BUF];
  uint32 err;

  tmpLen = (uint8)osal_strlen( (char*)title );
  if ( tmpLen )
  {
    osal_memcpy( buf, title, tmpLen );
    buf[tmpLen++] = ' ';
  }

  err = (uint32)(value1);
  _ltoa( err, &buf[tmpLen], format1 );
  tmpLen = (uint8)osal_strlen( (char*)buf );

  buf[tmpLen++] = ',';
  buf[tmpLen++] = ' ';
  err = (uint32)(value2);
  _ltoa( err, &buf[tmpLen], format2 );

  HalLcdWriteString( (char *)buf, line );		
#endif /* HAL_LCD */
}

/**************************************************************************************************
 * @fn      HalLcdDisplayPercentBar
 *
 * @brief   Display percentage bar on the LCD
 *
 * @param   title   -
 *          value   -
 *
 * @return  None
 **************************************************************************************************/
void HalLcdDisplayPercentBar( char *title, uint8 value )
{
#if (HAL_LCD == TRUE)
  uint8 percent;
  uint8 leftOver;
  uint8 buf[HAL_LCD_MAX_CHARS+1];
  uint32 err;
  uint8 x;

  /* Write the title: */
  HalLcdWriteString( title, HAL_LCD_LINE_1 );

  if ( value > 100 )
    value = 100;

  /* convert to blocks */
  percent = (byte)(value / 10);
  leftOver = (byte)(value % 10);

  /* Make window */
  osal_memcpy( buf, "[          ]  ", 15 );

  for ( x = 0; x < percent; x ++ )
  {
    buf[1+x] = '>';
  }

  if ( leftOver >= 5 )
    buf[1+x] = '+';

  err = (uint32)value;
  _ltoa( err, (uint8*)&buf[13], 10 );

  HalLcdWriteString( (char*)buf, HAL_LCD_LINE_2 );
#endif /* HAL_LCD */
}


/**************************************************************************************************
**************************************************************************************************/

